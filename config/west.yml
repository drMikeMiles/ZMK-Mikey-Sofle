## config/west.yml
```yaml
manifest:
  remotes:
    - name: zmkfirmware
      url-base: https://github.com/zmkfirmware
      # Additional modules containing boards/shields/custom code can be listed here as well.
      # See:
      # - https://zmk.dev/docs/features/modules
      # - https://docs.zephyrproject.org/3.5.0/develop/west/manifest.html#projects
    - name: m165437                        #Gem
      url-base: https://github.com/M165437 #Gem
    - name: gpeye                          #ForRightSide
      url-base: https://github.com/GPeye   #ForRightSide
  projects:
    - name: eyelash_sofle
      url: https://github.com/a741725193/zmk-sofle
      revision: refactor
    - name: nice-view-gem                  #Gem
      remote: m165437                      #Gem
      revision: main                       #Gem
    - name: hammerbeam-slideshow          #ForRightSide
      remote: gpeye                       #ForRightSide
      revision: main                      #ForRightSide
    - name: zmk
      remote: zmkfirmware
      revision: main
      import: app/west.yml
  self:
    path: config
```
